## components/effects/Kconfig.projbuild
```kconfig
menu "Bias Light: LED output"

    config LED_GPIO
        int "WS2812B data GPIO"
        range 0 33
        default 18
        help
            Output-capable GPIO connected to the strip's DIN (via a level shifter
            and series resistor, see README). Avoid GPIO 6-11 (flash).

    config LED_COUNT
        int "Number of LEDs"
        range 1 300
        default 60

    config MAX_BRIGHTNESS_PCT
        int "Hard brightness cap (percent of full output)"
        range 1 100
        default 40
        help
            The API brightness range 0..100 is scaled onto 0..this value, so no
            input can ever drive the strip above this cap.

    config RENDER_FPS
        int "Render loop frame rate"
        range 10 120
        default 60

    config DEFAULT_BRIGHTNESS_PCT
        int "Default brightness (0-100, within the cap range) when no state is saved"
        range 0 100
        default 50

endmenu
```

## components/homekit/Kconfig.projbuild
```kconfig
menu "Bias Light: HomeKit"

    config HOMEKIT_ENABLE
        bool "Enable Apple HomeKit accessory"
        default y

    config HOMEKIT_SETUP_CODE
        string "HomeKit setup (pairing) code, format xxx-xx-xxx"
        default ""
        depends on HOMEKIT_ENABLE
        help
            Leave empty (recommended) to generate a random code on first boot.
            It is stored in NVS and printed on the serial console at every boot.
            If you set one, it must not be a trivial or well-known code
            (e.g. 111-22-333, 123-45-678); invalid codes disable HomeKit.
            Note that a code set here is visible in your local sdkconfig and
            in the firmware image.

    config HOMEKIT_ACCESSORY_NAME
        string "Accessory name shown in the Home app"
        default "TV Light"
        depends on HOMEKIT_ENABLE

endmenu
```

## components/storage/Kconfig.projbuild
```kconfig
menu "Bias Light: Persistence"

    config STORAGE_SAVE_DEBOUNCE_MS
        int "Debounce before writing state to NVS (ms)"
        range 1000 600000
        default 5000
        help
            State changes are coalesced; flash is written at most once per
            this interval to limit wear.

endmenu
```

## components/wifi_mgr/Kconfig.projbuild
```kconfig
menu "Bias Light: Network"

    config WIFI_SSID
        string "Wi-Fi SSID"
        default ""
        help
            Network to join in station mode. Leave empty to skip Wi-Fi (the
            strip still runs with its saved/default state).

    config WIFI_PASSWORD
        string "Wi-Fi password"
        default ""

    config MDNS_HOSTNAME
        string "mDNS hostname (without .local)"
        default "tvlight"

    config WIFI_RETRY_MAX_DELAY_MS
        int "Maximum reconnect back-off (ms)"
        range 1000 60000
        default 15000

endmenu
```

## main/Kconfig.projbuild
```kconfig
menu "Bias Light: Diagnostics"

    config HEAP_LOG_INTERVAL_S
        int "Free-heap log interval (seconds)"
        range 5 3600
        default 60
        help
            Periodically logs free and minimum-ever free heap for soak testing.

endmenu
```
